## DooiSoftware/image/Kconfig.images
```kconfig
# SPDX-License-Identifier: Apache-2.0

DT_CHOSEN_Z_FLASH_RES_CP_IMAGE := resource,cp
DT_CHOSEN_Z_FLASH_RES_LITTLEFS_IMAGE := resource,littlefs
DT_CHOSEN_Z_FLASH_RES_SPD_BODY_DETECT := resource,spd_body_detect
DT_CHOSEN_Z_FLASH_RES_SPD_KEY_POINTS := resource,spd_key_points
DT_CHOSEN_Z_FLASH_RES_SPD_SIT_POSE := resource,spd_sit_pose
DT_CHOSEN_Z_FLASH_RES_WAKEUP_CAE_MLP := resource,wakeup_cae_mlp
DT_CHOSEN_Z_FLASH_RES_WAKEUP_ESR_MLP := resource,wakeup_esr_mlp

DT_CHOSEN_Z_FLASH_RES_WAKEUP_AI_WRAP_CONF := resource,wakeup_ai_wrap_conf
DT_CHOSEN_Z_FLASH_RES_QRCODE_DETECT := resource,qrcode_detect

config FLASH_RES_IMAGE_ADDRESS
	hex "second core firmware space start address"
	default "$(dt_chosen_reg_addr_hex,$(DT_CHOSEN_Z_FLASH_RES_CP_IMAGE))"

config FLASH_RES_IMAGE_SIZE
	hex "second core firmware space size"
	default "$(dt_chosen_reg_size_hex,$(DT_CHOSEN_Z_FLASH_RES_CP_IMAGE))"

config FLASH_RES_LITTLEFS_IMAGE_ADDRESS
	hex "littlefs space start address"
	default "$(dt_chosen_reg_addr_hex,$(DT_CHOSEN_Z_FLASH_RES_LITTLEFS_IMAGE))"

config FLASH_RES_LITTLEFS_IMAGE_SIZE
	hex "littlefs space size"
	default "$(dt_chosen_reg_size_hex,$(DT_CHOSEN_Z_FLASH_RES_LITTLEFS_IMAGE))"

config FLASH_RES_SPD_BODY_DETECT_ADDRESS
	hex "algorithm resource data space start address"
	default "$(dt_chosen_reg_addr_hex,$(DT_CHOSEN_Z_FLASH_RES_SPD_BODY_DETECT))"

config FLASH_RES_SPD_BODY_DETECT_SIZE
	hex "algorithm resource data space size"
	default "$(dt_chosen_reg_size_hex,$(DT_CHOSEN_Z_FLASH_RES_SPD_BODY_DETECT))"

config FLASH_RES_SPD_KEY_POINTS_ADDRESS
	hex "algorithm resource data space start address"
	default "$(dt_chosen_reg_addr_hex,$(DT_CHOSEN_Z_FLASH_RES_SPD_KEY_POINTS))"

config FLASH_RES_SPD_KEY_POINTS_SIZE
	hex "algorithm resource data space size"
	default "$(dt_chosen_reg_size_hex,$(DT_CHOSEN_Z_FLASH_RES_SPD_KEY_POINTS))"

config FLASH_RES_SPD_SIT_POSE_ADDRESS
	hex "algorithm resource data space start address"
	default "$(dt_chosen_reg_addr_hex,$(DT_CHOSEN_Z_FLASH_RES_SPD_SIT_POSE))"

config FLASH_RES_SPD_SIT_POSE_SIZE
	hex "algorithm resource data space size"
	default "$(dt_chosen_reg_size_hex,$(DT_CHOSEN_Z_FLASH_RES_SPD_SIT_POSE))"

config FLASH_RES_WAKEUP_CAE_MLP_ADDRESS
	hex "Wakeup algorithm resource data space start address"
	default "$(dt_chosen_reg_addr_hex,$(DT_CHOSEN_Z_FLASH_RES_WAKEUP_CAE_MLP))"

config FLASH_RES_WAKEUP_CAE_MLP_SIZE
	hex "Wakeup algorithm resource data space size"
	default "$(dt_chosen_reg_size_hex,$(DT_CHOSEN_Z_FLASH_RES_WAKEUP_CAE_MLP))"

config FLASH_RES_WAKEUP_AI_WRAP_CONF_ADDRESS
	hex "Wakeup algorithm resource data space start address"
	default "$(dt_chosen_reg_addr_hex,$(DT_CHOSEN_Z_FLASH_RES_WAKEUP_AI_WRAP_CONF))"

config FLASH_RES_WAKEUP_AI_WRAP_CONF_SIZE
	hex "Wakeup algorithm resource data space size"
	default "$(dt_chosen_reg_size_hex,$(DT_CHOSEN_Z_FLASH_RES_WAKEUP_AI_WRAP_CONF))"

config FLASH_RES_QRCODE_DETECT_ADDRESS
	hex "algorithm resource data space start address"
	default "$(dt_chosen_reg_addr_hex,$(DT_CHOSEN_Z_FLASH_RES_QRCODE_DETECT))"

config FLASH_RES_QRCODE_DETECT_SIZE
	hex "algorithm resource data space size"
	default "$(dt_chosen_reg_size_hex,$(DT_CHOSEN_Z_FLASH_RES_QRCODE_DETECT))"
```

## DooiSources/SDKCore/csk6_dooi_robot_v1/Kconfig.board
```kconfig
# SPDX-License-Identifier: Apache-2.0

config BOARD_CSK6_DOOI_ROBOT_V1
   bool "csk6_dooi_robot_v1 Board"
   depends on SOC_CSK6
```

## DooiSources/SDKCore/csk6_dooi_robot_v1/Kconfig.defconfig
```kconfig
if BOARD_CSK6_DOOI_ROBOT_V1

config BOARD
   default "csk6_dooi_robot_v1"

DT_CHOSEN_Z_PSRAM := zephyr,psram

config PSRAM_SIZE
	hex
	default "$(dt_chosen_reg_size_hex,$(DT_CHOSEN_Z_PSRAM))"

if WIFI

choice CSK_WIFI_OFFLOAD_MODULE
   prompt "WiFi Offload Module"
   default CSK_WIFI_ESP32C3

	config CSK_WIFI_ESP32C3
      bool "ESP32C3"

	config CSK_WIFI_XR819S
      bool "XR819S"

endchoice

endif # WIFI

endif # BOARD_CSK6_DOOI_ROBOT_V1
```

## DooiSources/SDKCore/display/Kconfig
```kconfig
rsource "Kconfig.csk6_lcd"
rsource "Kconfig.st7789v_csk6"
rsource "Kconfig.dual_gc9a01_csk6"
```

## DooiSources/SDKCore/display/Kconfig.dual_gc9a01_csk6
```kconfig
# GC9A01 display driver configuration options

# Copyright (c) 2024 Your Name <your.email@example.com>
# SPDX-License-Identifier: Apache-2.0

menuconfig DUAL_GC9A01_CSK6
    bool "Dual GC9A01 display driver"
    depends on SPI
    select MUTEX
    select DISPLAY_CSK6_LCD
    help
      Enable driver for GC9A01 display driver.

config GC9A01_CSK6_DMA_CHANNEL
	int "GC9A01_CSK6_DMA_CHANNEL"
	default 0

config GC9A01_CSK6_ROTATE_90
	bool "GC9A01_CSK6_ROTATE_90"
	default n


choice GC9A01_PIXEL_FORMAT
    prompt "Color pixel format"
    default GC9A01_RGB565
    depends on GC9A01_CSK6
    help
      Specify the color pixel format for the GC9A01 display controller.

config GC9A01_RGB565
    bool "RGB565"

endchoice
```
